/**
 * Elecrow CrowPanel 7.0" (basic DIS08070H or Advance) — Color Clock with Web Configuration
 *
 * Background color = RGB where:
 *   R = hours   (0-23)  mapped → 0-255
 *   G = minutes (0-59)  mapped → 0-255
 *   B = seconds (0-59)  mapped → 0-255
 *
 * Text color auto-selected via WCAG contrast ratio.
 * Double-buffered PSRAM framebuffers, swapped at frame end, for tear-free updates.
 *
 * Configurable via web UI at http://colorclock.local (or device IP):
 *   - NTP server
 *   - Time zone (POSIX TZ string, presets + custom)
 *   - 12h / 24h format
 *   - Show / hide seconds
 *   - Show / hide date
 *   - Color gamma (the basic board's TN panel renders mid-tones pale)
 *   - Brightness, plus dim and off schedules; tap to brighten for N seconds
 *   - Hourly chime (Advance board's buzzer)
 * Brightness, format, schedules and chime are also on screen: tap the top-left
 * and top-right corners within 5 s.
 *
 * Runs offline from the Advance board's RTC when WiFi is down.
 * WiFi setup via tzapu WiFiManager captive portal.
 * Touch & hold the screen during the boot splash to reset WiFi credentials.
 * (On the basic board GPIO 0 / BOOT is the display pixel clock, so it can't be used.)
 *
 * Libraries (install via Library Manager):
 *   - LovyanGFX   by lovyan03
 *   - WiFiManager by tzapu
 *   (Preferences, WebServer, ESPmDNS, Wire are built-in to the ESP32 core.)
 *
 * Build as "ESP32S3 Dev Module" with OPI PSRAM (see README.md for full FQBNs).
 * Board selection and all display / touch hardware details live in crowpanel7.h/.cpp.
 */

#include <WiFi.h>
#include <WiFiManager.h>
#include <WebServer.h>
#include <ESPmDNS.h>
#include <Preferences.h>
#include <time.h>
#include <sys/time.h>
#include <esp_sntp.h>
#include "crowpanel7.h"
#include "fonts.h"        // smooth fonts, generated by tools/make_fonts.py
#include "smooth_font.h"
#include "app_types.h"

// Drawing a smooth-font glyph alloca()s its whole bitmap (up to ~21 KB for the
// big time digits), far past the default 8 KB loop stack.
SET_LOOP_TASK_STACK_SIZE(FONTS_MAX_GLYPH_BYTES + 12 * 1024);

// ── Defaults ─────────────────────────────────────────────────────────────────
const char* DEFAULT_NTP        = "pool.ntp.org";
const char* DEFAULT_TZ         = "MST7MDT,M3.2.0,M11.1.0";   // Mountain Time w/ DST
const char* DEFAULT_TZ_LABEL   = "Mountain (MST/MDT)";
const char* AP_NAME            = "ColorClock-Setup";
const char* AP_PASSWORD        = "sopretty";      // min 8 chars for WPA2
const char* HOSTNAME           = "colorclock";    // DHCP hostname
const char* MDNS_NAME          = "colorclock";    // → http://colorclock.local
#if defined(BOARD_CROWPANEL_7)
const float DEFAULT_GAMMA      = 1.8f;    // TN panel: darken pale mid-tones
#else
const float DEFAULT_GAMMA      = 1.0f;    // IPS: start uncorrected, tune in the web UI
#endif
const float MIN_GAMMA          = 1.0f;
const float MAX_GAMMA          = 3.0f;
// ─────────────────────────────────────────────────────────────────────────────

#define WIFI_RESET_WINDOW_MS 3000   // how long the boot splash waits for a touch
#define WIFI_RESET_HOLD_MS   2000   // how long the touch must be held
#define TIME_SUFFIX_GAP      16     // px between time digits and AM/PM (matches make_fonts.py)

CrowPanel7  display;
LGFX_Sprite spr;      // always bound to the display's off-screen framebuffer

void bindSprite() {
  spr.setBuffer(display.backBuffer(), SCREEN_W, SCREEN_H, 16);
}

// Put the finished frame on screen and point the sprite at the next back buffer.
void presentFrame() {
  display.present();
  bindSprite();
}

// ── Smooth fonts (anti-aliased VLW, parsed once at boot from fonts.h) ──────
SmoothFont fontText24, fontText40, fontText56;
SmoothFont fontTimeL, fontTimeM, fontTimeS;   // time digits: no secs / 24h+secs / 12h+secs

void loadFonts() {
  fontText24.load(FONT_TEXT_24);
  fontText40.load(FONT_TEXT_40);
  fontText56.load(FONT_TEXT_56);
  fontTimeL.load(FONT_TIME_L);
  fontTimeM.load(FONT_TIME_M);
  fontTimeS.load(FONT_TIME_S);
}

void useFont(SmoothFont& f) {
  spr.setFont(&f.font);
  spr.setTextSize(1);
}
WebServer   server(80);
Preferences prefs;

// ── Settings (persisted in NVS) ──────────────────────────────────────────────
struct Settings {
  String ntp_server;
  String tz_string;
  bool   format_24h;
  bool   show_seconds;
  bool   show_date;
  float  gamma;          // applied to the background color; 1.0 = off
  uint8_t  brightness;   // normal backlight, percent
  bool     dim_enabled;  // dim schedule
  uint16_t dim_start;    // minutes after midnight
  uint16_t dim_end;
  uint8_t  dim_level;    // backlight while dimmed, percent
  bool     off_enabled;  // screen-off schedule (wins where it overlaps dim)
  uint16_t off_start;
  uint16_t off_end;
  uint16_t wake_s;       // how long a tap brightens the screen when dim / off
  bool     chime;        // hourly beep (boards with a buzzer), quiet when dim / off
} settings;

void loadSettings() {
  prefs.begin("clock", true);
  settings.ntp_server   = prefs.getString("ntp",   DEFAULT_NTP);
  settings.tz_string    = prefs.getString("tz",    DEFAULT_TZ);
  settings.format_24h   = prefs.getBool  ("fmt24", true);
  settings.show_seconds = prefs.getBool  ("secs",  true);
  settings.show_date    = prefs.getBool  ("date",  true);
  settings.gamma        = prefs.getFloat ("gamma", DEFAULT_GAMMA);
  settings.brightness   = prefs.getUChar ("bright", 100);
  settings.dim_enabled  = prefs.getBool  ("dim",    false);
  settings.dim_start    = prefs.getUShort("dstart", 20 * 60);
  settings.dim_end      = prefs.getUShort("dend",   22 * 60);
  settings.dim_level    = prefs.getUChar ("dlevel", 30);
  // The off schedule falls back to the old single night-mode keys.
  settings.off_enabled  = prefs.getBool  ("off",    prefs.getBool  ("night",  false));
  settings.off_start    = prefs.getUShort("ostart", prefs.getUShort("nstart", 22 * 60));
  settings.off_end      = prefs.getUShort("oend",   prefs.getUShort("nend",   7 * 60));
  settings.wake_s       = prefs.getUShort("wake",   prefs.getUShort("nwake",  30));
  settings.chime        = prefs.getBool  ("chime",  false);
  prefs.end();
}

void saveSettings() {
  prefs.begin("clock", false);
  prefs.putString("ntp",   settings.ntp_server);
  prefs.putString("tz",    settings.tz_string);
  prefs.putBool  ("fmt24", settings.format_24h);
  prefs.putBool  ("secs",  settings.show_seconds);
  prefs.putBool  ("date",  settings.show_date);
  prefs.putFloat ("gamma", settings.gamma);
  prefs.putUChar ("bright", settings.brightness);
  prefs.putBool  ("dim",    settings.dim_enabled);
  prefs.putUShort("dstart", settings.dim_start);
  prefs.putUShort("dend",   settings.dim_end);
  prefs.putUChar ("dlevel", settings.dim_level);
  prefs.putBool  ("off",    settings.off_enabled);
  prefs.putUShort("ostart", settings.off_start);
  prefs.putUShort("oend",   settings.off_end);
  prefs.putUShort("wake",   settings.wake_s);
  prefs.putBool  ("chime",  settings.chime);
  prefs.end();
}

void logSettings(const char* what) {
  Serial.printf("%s: ntp=%s tz=%s 24h=%d secs=%d date=%d gamma=%.1f bright=%u%% "
                "dim=%d %s-%s at %u%% off=%d %s-%s wake=%us chime=%d\n", what,
                settings.ntp_server.c_str(), settings.tz_string.c_str(),
                settings.format_24h, settings.show_seconds, settings.show_date,
                settings.gamma, settings.brightness,
                settings.dim_enabled, hhmm(settings.dim_start).c_str(), hhmm(settings.dim_end).c_str(),
                settings.dim_level,
                settings.off_enabled, hhmm(settings.off_start).c_str(), hhmm(settings.off_end).c_str(),
                settings.wake_s, settings.chime);
}

// Set from the SNTP task on each sync; loop() copies the time into the RTC
// (I2C stays on the loop task, which also owns touch and backlight).
volatile bool ntpSynced = false;
bool wifiOnline = false;

// True once the clock has been set, by the RTC or NTP (anything after 2024-01-01).
bool timeKnown() { return time(nullptr) > 1704067200; }

void applyTimeSettings() {
  // ESP32 built-in SNTP — handles DST via POSIX TZ string
  configTzTime(settings.tz_string.c_str(), settings.ntp_server.c_str());
  sntp_set_time_sync_notification_cb([](struct timeval*) { ntpSynced = true; });
}

// Battery-backed RTC (Advance board only): sets the clock at boot, before NTP.
void restoreTimeFromRtc() {
  time_t utc;
  if (!display.readRtc(utc)) {
    Serial.println("RTC: none, or no valid time");
    return;
  }
  timeval tv = { utc, 0 };
  settimeofday(&tv, nullptr);
  Serial.printf("RTC: %s", asctime(gmtime(&utc)));   // UTC; asctime ends in '\n'
}

// ── Color mapping ─────────────────────────────────────────────────────────────
inline uint8_t mapH(int h) { return (uint8_t)((h * 255) / 23); }
inline uint8_t mapM(int m) { return (uint8_t)((m * 255) / 59); }
inline uint8_t mapS(int s) { return (uint8_t)((s * 255) / 59); }

// Background gamma correction: the CrowPanel's panel shows mid-tones much
// lighter than the T-Display's IPS, so darken them before display. The hex
// and R/G/B readouts still show the uncorrected time-mapped values.
uint8_t gammaLut[256];

void buildGammaLut() {
  for (int i = 0; i < 256; i++) {
    gammaLut[i] = (uint8_t)lroundf(powf(i / 255.0f, settings.gamma) * 255.0f);
  }
}

uint16_t rgb888to565(uint8_t r, uint8_t g, uint8_t b) {
  return ((uint16_t)(r & 0xF8) << 8) |
         ((uint16_t)(g & 0xFC) << 3) |
         ((uint16_t)(b >> 3));
}

// ── WCAG contrast / text color selection ─────────────────────────────────────
static uint16_t linearise(uint8_t c) {
  float cf  = c / 255.0f;
  float lin = (cf <= 0.04045f) ? (cf / 12.92f)
                                : powf((cf + 0.055f) / 1.055f, 2.4f);
  return (uint16_t)(lin * 1000.0f);
}

static uint32_t luminance1000(uint8_t r, uint8_t g, uint8_t b) {
  return (212UL * linearise(r) +
          715UL * linearise(g) +
           72UL * linearise(b)) / 1000UL;
}

static uint32_t contrastRatio100(uint32_t L1, uint32_t L2) {
  uint32_t hi = max(L1, L2) + 50;
  uint32_t lo = min(L1, L2) + 50;
  return (hi * 100UL) / lo;
}

uint16_t bestTextColor(uint8_t r, uint8_t g, uint8_t b) {
  uint32_t bgLum = luminance1000(r, g, b);
  struct Candidate { uint8_t r, g, b; uint16_t col565; };
  Candidate candidates[] = {
    {255, 255, 255, TFT_WHITE},
    {  0,   0,   0, TFT_BLACK},
    {180, 180, 180, rgb888to565(180, 180, 180)},
    { 80,  80,  80, rgb888to565( 80,  80,  80)},
  };

  uint32_t bestCR  = 0;
  uint16_t bestCol = TFT_WHITE;
  for (auto& c : candidates) {
    uint32_t lum = luminance1000(c.r, c.g, c.b);
    uint32_t cr  = contrastRatio100(bgLum, lum);
    if (cr > bestCR) { bestCR = cr; bestCol = c.col565; }
  }
  return bestCol;
}

// ── Calendar names (tm_wday: 0=Sun; tm_mon: 0=Jan) ──────────────────────────
const char* dayNames[]   = {"Sun","Mon","Tue","Wed","Thu","Fri","Sat"};
const char* monthNames[] = {"Jan","Feb","Mar","Apr","May","Jun",
                              "Jul","Aug","Sep","Oct","Nov","Dec"};

String pad2(int n) { return (n < 10 ? "0" : "") + String(n); }

// ── Format time string per settings ─────────────────────────────────────────
// Digits only ("13:05:09" or "1:05:09"); AM/PM comes from amPm().
String formatTimeDigits(const struct tm& ti) {
  String out;
  if (settings.format_24h) {
    out = pad2(ti.tm_hour);
  } else {
    int h12 = ti.tm_hour % 12; if (h12 == 0) h12 = 12;
    out = String(h12);
  }
  out += ":" + pad2(ti.tm_min);
  if (settings.show_seconds) out += ":" + pad2(ti.tm_sec);
  return out;
}

const char* amPm(const struct tm& ti) {
  if (settings.format_24h) return "";
  return ti.tm_hour < 12 ? "AM" : "PM";
}

String formatTime(const struct tm& ti) {
  String out = formatTimeDigits(ti);
  if (!settings.format_24h) out += String(" ") + amPm(ti);
  return out;
}

// "HH:MM" <-> minutes after midnight (for the schedule time inputs)
String hhmm(uint16_t minutes) { return pad2(minutes / 60) + ":" + pad2(minutes % 60); }

int parseHHMM(const String& s) {
  int colon = s.indexOf(':');
  if (colon < 1) return -1;
  int h = s.substring(0, colon).toInt(), m = s.substring(colon + 1).toInt();
  if (h < 0 || h > 23 || m < 0 || m > 59) return -1;
  return h * 60 + m;
}

// ── Status / boot screens ───────────────────────────────────────────────────
void drawStatus(const String& l1, const String& l2, uint16_t color) {
  spr.fillSprite(TFT_BLACK);
  spr.setTextDatum(MC_DATUM);
  spr.setTextColor(color, TFT_BLACK);
  useFont(fontText56);
  if (l2.length() == 0) {
    spr.drawString(l1, SCREEN_W/2, SCREEN_H/2);
  } else {
    spr.drawString(l1, SCREEN_W/2, SCREEN_H/2 - 40);
    useFont(fontText40);
    spr.setTextColor(TFT_WHITE, TFT_BLACK);
    spr.drawString(l2, SCREEN_W/2, SCREEN_H/2 + 40);
  }
}

void showStatus(const String& l1, const String& l2 = "", uint16_t color = TFT_CYAN) {
  drawStatus(l1, l2, color);
  presentFrame();
}

void portalCallback(WiFiManager* wm) {
  spr.fillSprite(TFT_BLUE);
  spr.setTextDatum(MC_DATUM);
  spr.setTextColor(TFT_WHITE, TFT_BLUE);
  useFont(fontText56);
  spr.drawString("WiFi Setup", SCREEN_W/2, 55);
  useFont(fontText40);
  spr.drawString("Connect phone to:", SCREEN_W/2, 140);
  useFont(fontText56);
  spr.setTextColor(TFT_YELLOW, TFT_BLUE);
  spr.drawString(AP_NAME, SCREEN_W/2, 215);
  useFont(fontText40);
  spr.setTextColor(TFT_WHITE, TFT_BLUE);
  spr.drawString(String("Password: ") + AP_PASSWORD, SCREEN_W/2, 300);
  spr.drawString("Then open: 192.168.4.1", SCREEN_W/2, 365);
  useFont(fontText24);
  spr.drawString("(captive portal will appear)", SCREEN_W/2, 430);
  presentFrame();
}

// ── Touch-hold WiFi reset at boot ───────────────────────────────────────────
// Shows a splash for WIFI_RESET_WINDOW_MS; returns true if the screen is held
// for WIFI_RESET_HOLD_MS, with a progress bar while it's held.
bool wifiResetRequested() {
  const int barX = 100, barY = SCREEN_H - 60, barW = SCREEN_W - 200, barH = 24;
  uint32_t start = millis(), heldSince = 0;
  while (true) {
    uint32_t now = millis();
    bool touched = display.touched();
    if (touched && heldSince == 0) heldSince = now;
    if (!touched) heldSince = 0;
    uint32_t held = touched ? now - heldSince : 0;

    drawStatus("Color Clock", "Touch & hold to reset WiFi", TFT_CYAN);
    if (touched) {
      spr.drawRect(barX - 2, barY - 2, barW + 4, barH + 4, TFT_WHITE);
      spr.fillRect(barX, barY, min<uint32_t>(held, WIFI_RESET_HOLD_MS) * barW / WIFI_RESET_HOLD_MS,
                   barH, TFT_RED);
    }
    presentFrame();   // paced by the panel's frame rate

    if (touched && held >= WIFI_RESET_HOLD_MS) return true;
    if (!touched && now - start >= WIFI_RESET_WINDOW_MS) return false;
  }
}

// ── Touch (polled once per loop pass) ───────────────────────────────────────
struct TouchState {
  bool down    = false;   // finger on the screen
  bool started = false;   // went down this pass
  int  x = 0, y = 0;      // last position while down
} touch;

void pollTouch() {
  int x, y;
  bool down = display.touchPoint(x, y);
  touch.started = down && !touch.down;
  touch.down = down;
  if (down) { touch.x = x; touch.y = y; }
  if (touch.started) Serial.printf("Touch at %d,%d\n", x, y);
}

// ── Dim / off schedules ─────────────────────────────────────────────────────
// start..end in minutes after midnight; may span midnight; equal = never.
bool inWindow(bool enabled, uint16_t start, uint16_t end, const struct tm& ti) {
  if (!enabled || start == end) return false;
  int now = ti.tm_hour * 60 + ti.tm_min;
  if (start < end) return now >= start && now < end;
  return now >= start || now < end;
}

Schedule scheduleAt(const struct tm& ti) {
  if (inWindow(settings.off_enabled, settings.off_start, settings.off_end, ti)) return SCHED_OFF;
  if (inWindow(settings.dim_enabled, settings.dim_start, settings.dim_end, ti)) return SCHED_DIM;
  return SCHED_NORMAL;
}

uint8_t  backlightLevel = 0;   // percent last sent to the backlight
uint8_t  wakeLevel = 0;        // level a tap raised the screen to
uint32_t wakeUntil = 0;        // millis() deadline of that tap-to-wake; 0 = none

void setBacklightLevel(uint8_t level, const char* why) {
  if (level == backlightLevel) return;   // on the Advance each change is an I2C write
  backlightLevel = level;
  display.setBrightness(level);
  Serial.printf("Backlight %u%% (%s)\n", level, why);
}

// Normal brightness, or the dim level / off per schedule. While dim or off a
// tap brightens one step for wake_s (off → dim level, dim → normal), re-armed
// while touching. Frames keep rendering while off, so the clock is current the
// moment the screen comes on. Returns true if this pass's tap was used to wake.
bool updateScreenPower(const struct tm& ti) {
  Schedule sched = scheduleAt(ti);
  uint8_t dimLevel  = min(settings.dim_level, settings.brightness);
  uint8_t scheduled = sched == SCHED_OFF ? 0 : sched == SCHED_DIM ? dimLevel : settings.brightness;

  if (wakeUntil && (int32_t)(millis() - wakeUntil) >= 0) wakeUntil = 0;
  uint8_t level = wakeUntil ? max(wakeLevel, scheduled) : scheduled;

  bool woke = false;
  if (touch.started && level < settings.brightness) {
    wakeLevel = level == 0 ? dimLevel : settings.brightness;
    level = wakeLevel;
    woke = true;
  }
  if (wakeUntil || woke) {
    if (touch.down) wakeUntil = (millis() + settings.wake_s * 1000UL) | 1;
  }
  setBacklightLevel(level, wakeUntil ? "tapped" : sched == SCHED_OFF ? "off schedule"
                         : sched == SCHED_DIM ? "dim schedule" : "normal");
  return woke;
}

// ── Hourly chime (boards with a buzzer) ─────────────────────────────────────
// Two short beeps, stepped from loop() so drawing isn't held up.
#define CHIME_BEEP_MS 120
uint8_t  chimeStep = 0;       // counts down: odd = beeping, even = gap, 0 = idle
uint32_t chimeNext = 0;       // millis() of the next step

void startChime() {
  if (!CrowPanel7::hasBuzzer()) return;
  chimeStep = 4;
  chimeNext = millis();
}

void updateChime() {
  if (!chimeStep || (int32_t)(millis() - chimeNext) < 0) return;
  chimeStep--;
  display.setBuzzer(chimeStep & 1);   // steps 3, 1 = on; 2, 0 = off
  chimeNext = millis() + CHIME_BEEP_MS;
}

// Chimes once at the top of each hour, unless the screen is scheduled dim / off. Only in
// the hour's first seconds, so a boot or settings save at hh:00:30 stays quiet.
void checkHourlyChime(const struct tm& ti) {
  static int lastChimeHour = -1;
  if (ti.tm_min != 0 || ti.tm_sec >= 10 || ti.tm_hour == lastChimeHour) return;
  lastChimeHour = ti.tm_hour;
  if (settings.chime && scheduleAt(ti) == SCHED_NORMAL) startChime();
}

// ── Web UI ──────────────────────────────────────────────────────────────────
const char SETTINGS_HTML[] PROGMEM = R"HTML(
<!DOCTYPE html><html><head>
<meta charset="utf-8">
<meta name="viewport" content="width=device-width,initial-scale=1">
<title>Color Clock</title>
<style>
*{box-sizing:border-box}
body{font-family:-apple-system,BlinkMacSystemFont,sans-serif;background:#111;color:#eee;padding:20px;max-width:500px;margin:auto;line-height:1.4}
h1{color:#6cf;margin-top:0}
h2{color:#6cf;font-size:16px;margin:25px 0 10px}
label{display:block;margin-top:14px;font-weight:600;font-size:14px}
input[type=text],input[type=time],input[type=number],select{width:100%;padding:10px;margin-top:5px;background:#222;color:#fff;border:1px solid #444;border-radius:4px;font-size:14px}
input[type=checkbox]{margin-right:8px;transform:scale(1.3);vertical-align:middle}
.cb{display:flex;align-items:center;margin-top:14px;font-weight:400}
button{margin-top:20px;padding:12px;background:#6cf;color:#000;border:0;font-size:15px;border-radius:4px;cursor:pointer;width:100%;font-weight:600}
button:hover{background:#8df}
button.danger{background:#822;color:#fff}
button.danger:hover{background:#a33}
.status{background:#1a1a1a;padding:15px;border-radius:6px;margin-bottom:20px;font-size:13px;border:1px solid #333}
.status div{margin:3px 0;display:flex;justify-content:space-between}
.status span:first-child{color:#888}
.status span:last-child{color:#fff;font-family:monospace}
input[type=range]{width:100%;margin-top:8px}
.hint{color:#888;font-size:12px;margin-top:4px}
.live{color:#6cf;font-size:18px;font-family:monospace}
hr{border:0;border-top:1px solid #333;margin:25px 0}
</style></head><body>
<h1>Color Clock</h1>

<div class="status">
<div><span>Current</span><span class="live" id="time">--:--:--</span></div>
<div><span>Hostname</span><span>%MDNS%.local</span></div>
<div><span>IP</span><span>%IP%</span></div>
<div><span>WiFi</span><span>%RSSI%</span></div>
<div><span>Uptime</span><span>%UPTIME%</span></div>
<div><span>Screen</span><span>%SCREEN%</span></div>
</div>

<form action="/save" method="POST">

<h2>Time Source</h2>
<label>NTP Server</label>
<input type="text" name="ntp" value="%NTP%">
<div class="hint">e.g. pool.ntp.org, time.google.com, time.cloudflare.com</div>

<label>Time Zone Preset</label>
<select onchange="if(this.value)document.querySelector('[name=tz]').value=this.value">
<option value="">— pick preset or use custom below —</option>
<option value="UTC0">UTC</option>
<option value="PST8PDT,M3.2.0,M11.1.0">US Pacific (PST/PDT)</option>
<option value="MST7MDT,M3.2.0,M11.1.0">US Mountain (MST/MDT)</option>
<option value="MST7">US Arizona (MST, no DST)</option>
<option value="CST6CDT,M3.2.0,M11.1.0">US Central (CST/CDT)</option>
<option value="EST5EDT,M3.2.0,M11.1.0">US Eastern (EST/EDT)</option>
<option value="HST10">Hawaii (HST)</option>
<option value="AKST9AKDT,M3.2.0,M11.1.0">Alaska (AKST/AKDT)</option>
<option value="GMT0BST,M3.5.0/1,M10.5.0">UK (GMT/BST)</option>
<option value="CET-1CEST,M3.5.0,M10.5.0/3">Central Europe (CET/CEST)</option>
<option value="EET-2EEST,M3.5.0/3,M10.5.0/4">Eastern Europe (EET/EEST)</option>
<option value="JST-9">Japan (JST)</option>
<option value="CST-8">China (CST)</option>
<option value="IST-5:30">India (IST)</option>
<option value="AEST-10AEDT,M10.1.0,M4.1.0/3">Sydney (AEST/AEDT)</option>
<option value="NZST-12NZDT,M9.5.0,M4.1.0/3">New Zealand (NZST/NZDT)</option>
</select>

<label>POSIX TZ String</label>
<input type="text" name="tz" value="%TZ%">
<div class="hint">Auto-filled from preset, or enter your own. Handles DST automatically.</div>

<h2>Display Format</h2>
<label class="cb"><input type="checkbox" name="fmt24" %FMT24%> 24-hour format (off = 12-hour AM/PM)</label>
<label class="cb"><input type="checkbox" name="secs"  %SECS%> Show seconds</label>
<label class="cb"><input type="checkbox" name="date"  %DATE%> Show date line</label>

<label>Color richness (gamma): <span id="gv">%GAMMA%</span></label>
<input type="range" name="gamma" min="1.0" max="3.0" step="0.1" value="%GAMMA%"
       oninput="document.getElementById('gv').textContent=this.value">
<div class="hint">Higher darkens mid-tones for deeper colors on this panel. 1.0 = no correction.</div>

<label>Brightness: <span id="bv">%BRIGHT%</span>%</label>
<input type="range" name="bright" min="5" max="100" step="5" value="%BRIGHT%"
       oninput="document.getElementById('bv').textContent=this.value">

<h2>Dim Schedule</h2>
<label class="cb"><input type="checkbox" name="dim" %DIM%> Dim the screen</label>
<label>From</label>
<input type="time" name="dstart" value="%DSTART%">
<label>Until</label>
<input type="time" name="dend" value="%DEND%">
<label>Dim brightness: <span id="dv">%DLEVEL%</span>%</label>
<input type="range" name="dlevel" min="5" max="100" step="5" value="%DLEVEL%"
       oninput="document.getElementById('dv').textContent=this.value">

<h2>Off Schedule</h2>
<label class="cb"><input type="checkbox" name="off" %OFF%> Turn the screen off</label>
<label>From</label>
<input type="time" name="ostart" value="%OSTART%">
<label>Until</label>
<input type="time" name="oend" value="%OEND%">
<div class="hint">Takes priority where it overlaps the dim schedule.</div>

<label>Tap to wake for (seconds)</label>
<input type="number" name="wake" min="5" max="3600" value="%WAKE%">
<div class="hint">While off, a tap shows the clock at the dim brightness; while dim, at full brightness.</div>

<div %CHIMESTYLE%>
<h2>Chime</h2>
<label class="cb"><input type="checkbox" name="chime" %CHIME%> Beep at the top of every hour</label>
<div class="hint">Quiet while the screen is scheduled dim or off.</div>
<button type="button" onclick="fetch('/chime',{method:'POST'})">Test chime</button>
</div>

<button type="submit">Save &amp; Apply</button>
</form>

<hr>

<form action="/reset_wifi" method="POST"
      onsubmit="return confirm('Wipe saved WiFi credentials and reboot?')">
<button type="submit" class="danger">Reset WiFi Credentials</button>
</form>

<script>
function tick(){
  fetch('/time').then(r=>r.text()).then(t=>{
    document.getElementById('time').textContent=t;
  }).catch(()=>{});
}
setInterval(tick,1000); tick();
</script>
</body></html>
)HTML";

// ── Web handlers ────────────────────────────────────────────────────────────
String uptimeString() {
  long s = millis() / 1000;
  char buf[32];
  snprintf(buf, sizeof(buf), "%ldd %02ld:%02ld:%02ld",
           s/86400, (s%86400)/3600, (s%3600)/60, s%60);
  return String(buf);
}

void handleRoot() {
  String html = FPSTR(SETTINGS_HTML);
  html.replace("%MDNS%",   MDNS_NAME);
  html.replace("%IP%",     WiFi.localIP().toString());
  html.replace("%RSSI%",   wifiOnline ? String(WiFi.RSSI()) + " dBm" : "offline");
  html.replace("%UPTIME%", uptimeString());
  html.replace("%NTP%",    settings.ntp_server);
  html.replace("%TZ%",     settings.tz_string);
  html.replace("%FMT24%",  settings.format_24h   ? "checked" : "");
  html.replace("%SECS%",   settings.show_seconds ? "checked" : "");
  html.replace("%DATE%",   settings.show_date    ? "checked" : "");
  html.replace("%GAMMA%",  String(settings.gamma, 1));
  html.replace("%DIM%",    settings.dim_enabled ? "checked" : "");
  html.replace("%DSTART%", hhmm(settings.dim_start));
  html.replace("%DEND%",   hhmm(settings.dim_end));
  html.replace("%DLEVEL%", String(settings.dim_level));
  html.replace("%OFF%",    settings.off_enabled ? "checked" : "");
  html.replace("%OSTART%", hhmm(settings.off_start));
  html.replace("%OEND%",   hhmm(settings.off_end));
  html.replace("%WAKE%",   String(settings.wake_s));
  html.replace("%BRIGHT%", String(settings.brightness));
  html.replace("%CHIME%",  settings.chime ? "checked" : "");
  html.replace("%CHIMESTYLE%", CrowPanel7::hasBuzzer() ? "" : "style=\"display:none\"");
  html.replace("%SCREEN%", backlightLevel == 0 ? String("Off (scheduled)")
                         : String(backlightLevel) + "%" + (wakeUntil ? " (tapped)"
                         : backlightLevel < settings.brightness ? " (dimmed)" : ""));
  server.send(200, "text/html", html);
}

void handleSave() {
  if (server.hasArg("ntp")) settings.ntp_server = server.arg("ntp");
  if (server.hasArg("tz"))  settings.tz_string  = server.arg("tz");
  settings.format_24h   = server.hasArg("fmt24");
  settings.show_seconds = server.hasArg("secs");
  settings.show_date    = server.hasArg("date");
  if (server.hasArg("gamma")) {
    settings.gamma = constrain(server.arg("gamma").toFloat(), MIN_GAMMA, MAX_GAMMA);
    buildGammaLut();
  }
  if (server.hasArg("bright")) settings.brightness = constrain(server.arg("bright").toInt(), 5, 100);
  int t;
  settings.dim_enabled = server.hasArg("dim");
  if ((t = parseHHMM(server.arg("dstart"))) >= 0) settings.dim_start = t;
  if ((t = parseHHMM(server.arg("dend")))   >= 0) settings.dim_end   = t;
  if (server.hasArg("dlevel")) settings.dim_level = constrain(server.arg("dlevel").toInt(), 5, 100);
  settings.off_enabled = server.hasArg("off");
  if ((t = parseHHMM(server.arg("ostart"))) >= 0) settings.off_start = t;
  if ((t = parseHHMM(server.arg("oend")))   >= 0) settings.off_end   = t;
  if (server.hasArg("wake")) settings.wake_s = constrain(server.arg("wake").toInt(), 5, 3600);
  settings.chime = server.hasArg("chime");
  saveSettings();
  applyTimeSettings();
  logSettings("Saved");
  server.sendHeader("Location", "/");
  server.send(303);
}

void handleTime() {
  struct tm ti;
  if (!getLocalTime(&ti, 50)) { server.send(200, "text/plain", "--:--:--"); return; }
  server.send(200, "text/plain", formatTime(ti));
}

void handleResetWiFi() {
  server.send(200, "text/html",
    "<meta http-equiv='refresh' content='3'>"
    "<body style='font-family:sans-serif;background:#111;color:#eee;padding:30px'>"
    "<h1>Resetting WiFi…</h1><p>Device will reboot into setup mode.</p></body>");
  delay(800);
  WiFiManager wm;
  wm.resetSettings();
  delay(500);
  ESP.restart();
}

// Panel tuning (not persisted): /panel?mhz=26.67 sets the pixel clock live and
// reports the measured refresh rate; /panel alone just reports it.
void handlePanel() {
  String msg;
  if (server.hasArg("mhz")) {
    uint32_t hz = (uint32_t)(server.arg("mhz").toFloat() * 1e6f);
    bool ok = hz >= 8000000 && hz <= 40000000 && display.setPixelClock(hz);
    msg += String(ok ? "set pclk " : "rejected pclk ") + server.arg("mhz") + " MHz\n";
    delay(200);   // let the new clock take effect
  }
  msg += "fps=" + String(display.measureFps(), 1) + "\n";
  Serial.print("Panel: " + msg);
  server.send(200, "text/plain", msg);
}

// Diagnostic: /test shows ramps of dark gray/red/green/blue (levels 0-120,
// raw — no gamma) to find which levels the panel visibly dithers. Stays up for
// 5 minutes or until /test?off.
uint32_t testPatternUntil = 0;   // millis() deadline; 0 = clock is showing

void drawTestPattern() {
  const char* rows[] = {"Gray", "Red", "Green", "Blue"};
  const int cols = 16, barW = SCREEN_W / cols, rowH = SCREEN_H / 4;
  spr.fillSprite(TFT_BLACK);
  useFont(fontText24);
  spr.setTextColor(TFT_WHITE);
  for (int r = 0; r < 4; r++) {
    for (int c = 0; c < cols; c++) {
      uint8_t v = c * 8;
      uint16_t col = rgb888to565(r == 0 || r == 1 ? v : 0,
                                 r == 0 || r == 2 ? v : 0,
                                 r == 0 || r == 3 ? v : 0);
      spr.fillRect(c * barW, r * rowH, barW, rowH, col);
      spr.setTextDatum(BC_DATUM);
      spr.drawString(String(v), c * barW + barW/2, r * rowH + rowH - 4);
    }
    spr.setTextDatum(TL_DATUM);
    spr.drawString(rows[r], 4, r * rowH + 4);
  }
  spr.setTextDatum(MC_DATUM);
  presentFrame();
}

void handleTest() {
  if (server.hasArg("off")) {
    testPatternUntil = millis() | 1;   // already expired → loop() restores the clock
    server.send(200, "text/plain", "clock restored\n");
    return;
  }
  drawTestPattern();
  testPatternUntil = (millis() + 300000) | 1;
  server.send(200, "text/plain", "test pattern on for 5 min; /test?off to return\n");
}

// Diagnostic: /snap returns the on-screen framebuffer as raw RGB565 (byte-swapped,
// 800x480). Blocks the loop while sending, so the buffer can't change mid-transfer.
void handleSnap() {
  const uint8_t* fb = (const uint8_t*)display.frontBuffer();
  const size_t len = SCREEN_W * SCREEN_H * 2;
  server.setContentLength(len);
  server.send(200, "application/octet-stream", "");
  for (size_t off = 0; off < len; off += 4096) {
    server.sendContent((const char*)fb + off, min<size_t>(4096, len - off));
  }
}

void handleChime() {
  startChime();
  server.send(204);
}

void handleNotFound() {
  server.send(404, "text/plain", "Not found");
}

void setupWebServer() {
  server.on("/",          handleRoot);
  server.on("/save",      HTTP_POST, handleSave);
  server.on("/time",      handleTime);
  server.on("/reset_wifi",HTTP_POST, handleResetWiFi);
  server.on("/panel",     handlePanel);
  server.on("/test",      handleTest);
  server.on("/snap",      handleSnap);
  server.on("/chime",     HTTP_POST, handleChime);
  server.onNotFound(handleNotFound);
  server.begin();

  if (MDNS.begin(MDNS_NAME)) {
    MDNS.addService("http", "tcp", 80);
    Serial.printf("mDNS: http://%s.local\n", MDNS_NAME);
  }
}

// ── WiFi setup via WiFiManager ──────────────────────────────────────────────
#define WIFI_CONNECT_MS  20000   // boot: wait this long for saved credentials
#define WIFI_RETRY_MS    30000   // offline: reconnect attempt interval

// Boot only. With saved credentials that don't connect in time, the clock runs
// offline if the time is already known (RTC) and loop() keeps retrying. The
// setup portal opens without saved credentials, after a touch-hold reset, or
// when there is no other way to get the time.
void setupWiFi() {
  WiFiManager wm;
  wm.setConfigPortalTimeout(180);
  wm.setAPCallback(portalCallback);
  wm.setDebugOutput(false);

  // Set hostname BEFORE connecting so DHCP advertises it correctly
  WiFi.mode(WIFI_STA);
  WiFi.setHostname(HOSTNAME);

  if (wifiResetRequested()) {
    showStatus("Resetting WiFi", "credentials...", TFT_RED);
    wm.resetSettings();
    delay(1500);
  }

  bool connected = false;
  if (wm.getWiFiIsSaved()) {
    showStatus("Connecting WiFi", "(saved creds)");
    WiFi.begin();
    for (uint32_t start = millis(); millis() - start < WIFI_CONNECT_MS; delay(100)) {
      if (WiFi.status() == WL_CONNECTED) { connected = true; break; }
    }
    if (!connected && timeKnown()) {
      showStatus("WiFi unavailable", "Running offline", TFT_ORANGE);
      delay(2500);
      return;
    }
  }

  if (!connected && !wm.startConfigPortal(AP_NAME, AP_PASSWORD)) {
    WiFi.mode(WIFI_STA);
    if (timeKnown()) {
      showStatus("Setup timeout", "Running offline", TFT_ORANGE);
      delay(2500);
      return;
    }
    showStatus("Setup timeout", "Restarting...", TFT_RED);
    delay(2000);
    ESP.restart();
  }

  wifiOnline = true;
  Serial.printf("WiFi connected: %s\n", WiFi.localIP().toString().c_str());
  showStatus("Connected!", WiFi.localIP().toString(), TFT_GREEN);
  delay(2000);
  showStatus("Web UI at:", String(MDNS_NAME) + ".local", TFT_CYAN);
  delay(2500);
}

// Runs every loop pass: the clock keeps going while WiFi is down, with a
// reconnect attempt every WIFI_RETRY_MS. On reconnect SNTP is restarted, which
// also corrects the RTC.
void checkWiFi() {
  static uint32_t lastTry = 0;
  bool up = WiFi.status() == WL_CONNECTED;
  if (up != wifiOnline) {
    wifiOnline = up;
    lastTry = millis();
    if (up) {
      Serial.printf("WiFi connected: %s\n", WiFi.localIP().toString().c_str());
      applyTimeSettings();
    } else {
      Serial.println("WiFi lost; retrying in the background");
    }
  }
  if (!up && millis() - lastTry >= WIFI_RETRY_MS) {
    lastTry = millis();
    WiFi.reconnect();
  }
}

// ── State ───────────────────────────────────────────────────────────────────
int lastH = -1, lastM = -1, lastS = -1;
bool lastFmt24 = true, lastSecs = true, lastDate = true;  // detect setting changes
float lastGamma = 0;
bool lastOnline = false;

// ── On-screen settings ──────────────────────────────────────────────────────
// Opened by tapping the top-left and top-right corners (either order) within
// CORNER_WINDOW_MS while the screen is at normal brightness. Changes apply
// live; Done, or CONFIG_IDLE_MS without a touch, saves and returns to the clock.
#define CORNER_W          160
#define CORNER_H          120
#define CORNER_WINDOW_MS  5000
#define CONFIG_IDLE_MS    60000
#define REPEAT_DELAY_MS   500     // hold +/- this long to auto-repeat
#define REPEAT_MS         120
#define DIM_PREVIEW_MS    2000    // show the dim level this long after changing it

#define TAB_W     160             // 4 page tabs + Done across the top
#define HEADER_H  80
#define ROWS_Y    100
#define ROW_H     95
#define CTRL_H    64

const char* configTabs[] = {"Clock", "Dim", "Off", "Chime"};
int configPageCount() { return CrowPanel7::hasBuzzer() ? 4 : 3; }

int configRows(int page, ConfigRow* rows) {
  switch (page) {
    case 0:
      rows[0] = {"Brightness",   ROW_PERCENT, &settings.brightness, 5, 100};
      rows[1] = {"24-hour",      ROW_TOGGLE,  &settings.format_24h};
      rows[2] = {"Seconds",      ROW_TOGGLE,  &settings.show_seconds};
      rows[3] = {"Date",         ROW_TOGGLE,  &settings.show_date};
      return 4;
    case 1:
      rows[0] = {"Dim screen",   ROW_TOGGLE,  &settings.dim_enabled};
      rows[1] = {"From",         ROW_TIME,    &settings.dim_start};
      rows[2] = {"Until",        ROW_TIME,    &settings.dim_end};
      rows[3] = {"Brightness",   ROW_PERCENT, &settings.dim_level, 5, 100};
      return 4;
    case 2:
      rows[0] = {"Screen off",   ROW_TOGGLE,  &settings.off_enabled};
      rows[1] = {"From",         ROW_TIME,    &settings.off_start};
      rows[2] = {"Until",        ROW_TIME,    &settings.off_end};
      return 3;
    default:
      rows[0] = {"Hourly chime", ROW_TOGGLE,  &settings.chime};
      rows[1] = {"Test chime",   ROW_ACTION,  nullptr};
      return 2;
  }
}

bool     configOpen = false;
int      configPage = 0;
bool     configDirty = false;     // redraw needed
uint32_t configLastTouch = 0;
uint32_t dimPreviewUntil = 0;     // 0 = no preview
int      heldRow = -1, heldDir = 0;
uint32_t nextRepeat = 0;
uint32_t cornerTapL = 0, cornerTapR = 0;   // millis() of the last tap in each top corner

void openConfig() {
  configOpen = true;
  configPage = 0;
  configDirty = true;
  configLastTouch = millis();
  heldRow = -1;
  Serial.println("On-screen settings opened");
}

void closeConfig() {
  configOpen = false;
  dimPreviewUntil = 0;
  saveSettings();
  logSettings("Saved (on screen)");
  lastS = -1;   // redraw the clock
  // Stay at normal brightness for wake_s, as after a tap, so a dim / off
  // schedule doesn't blank the screen the instant Done is pressed.
  wakeLevel = settings.brightness;
  wakeUntil = (millis() + settings.wake_s * 1000UL) | 1;
}

// A tap in one top corner, then the other within CORNER_WINDOW_MS, opens the settings.
void checkCornerTaps() {
  if (!touch.started || touch.y >= CORNER_H) return;
  uint32_t now = millis(), other;
  if (touch.x < CORNER_W)                  { cornerTapL = now | 1; other = cornerTapR; }
  else if (touch.x >= SCREEN_W - CORNER_W) { cornerTapR = now | 1; other = cornerTapL; }
  else return;
  if (other && now - other <= CORNER_WINDOW_MS) {
    cornerTapL = cornerTapR = 0;
    openConfig();
  }
}

String configTimeString(uint16_t minutes) {
  if (settings.format_24h) return hhmm(minutes);
  int h = minutes / 60, h12 = h % 12 ? h % 12 : 12;
  return String(h12) + ":" + pad2(minutes % 60) + (h < 12 ? " AM" : " PM");
}

void drawButton(int x, int y, int w, int h, uint16_t bg, const char* text, uint16_t fg) {
  spr.fillRoundRect(x, y, w, h, 12, bg);
  if (text) {
    spr.setTextColor(fg, bg);
    spr.drawString(text, x + w / 2, y + h / 2);
  }
}

// +/- drawn as bars: the fonts are ASCII-only and a text '-' is too thin to aim at.
void drawStepButton(int x, int y, int w, int h, uint16_t bg, bool plus) {
  drawButton(x, y, w, h, bg, nullptr, 0);
  int cx = x + w / 2, cy = y + h / 2;
  spr.fillRect(cx - 16, cy - 4, 32, 8, TFT_WHITE);
  if (plus) spr.fillRect(cx - 4, cy - 16, 8, 32, TFT_WHITE);
}

void drawConfig(const ConfigRow* rows, int n) {
  const uint16_t BG     = rgb888to565(18, 18, 22);
  const uint16_t PANEL  = rgb888to565(58, 58, 66);
  const uint16_t ACCENT = rgb888to565(102, 204, 255);
  const uint16_t GREEN  = rgb888to565(40, 160, 90);

  spr.fillSprite(BG);
  spr.setTextDatum(MC_DATUM);
  useFont(fontText40);
  for (int t = 0; t < configPageCount(); t++) {
    bool active = t == configPage;
    drawButton(t * TAB_W + 6, 8, TAB_W - 12, HEADER_H - 16, active ? ACCENT : PANEL,
               configTabs[t], active ? TFT_BLACK : TFT_WHITE);
  }
  drawButton(4 * TAB_W + 6, 8, TAB_W - 12, HEADER_H - 16, GREEN, "Done", TFT_WHITE);

  for (int i = 0; i < n; i++) {
    const ConfigRow& r = rows[i];
    int cy = ROWS_Y + i * ROW_H + ROW_H / 2, top = cy - CTRL_H / 2;
    useFont(fontText40);
    spr.setTextDatum(ML_DATUM);
    spr.setTextColor(TFT_WHITE, BG);
    spr.drawString(r.label, 40, cy);
    spr.setTextDatum(MC_DATUM);

    if (r.kind == ROW_TOGGLE) {
      bool on = *(bool*)r.value;
      drawButton(600, top, 180, CTRL_H, on ? GREEN : PANEL, on ? "ON" : "OFF", TFT_WHITE);
    } else if (r.kind == ROW_ACTION) {
      drawButton(560, top, 220, CTRL_H, PANEL, "Play", TFT_WHITE);
    } else {
      String v = r.kind == ROW_PERCENT ? String(*(uint8_t*)r.value) + "%"
                                       : configTimeString(*(uint16_t*)r.value);
      drawStepButton(410, top, 90, CTRL_H, PANEL, false);
      drawStepButton(690, top, 90, CTRL_H, PANEL, true);
      if (spr.textWidth(v) > 180) useFont(fontText24);
      spr.setTextColor(TFT_WHITE, BG);
      spr.drawString(v, 595, cy);
    }
  }
  presentFrame();
}

// Percent in steps of 5; times in steps of 15 min, snapped to the quarter hour, wrapping at midnight.
void stepRow(const ConfigRow& r, int dir) {
  if (r.kind == ROW_PERCENT) {
    uint8_t* v = (uint8_t*)r.value;
    *v = constrain((int)*v + dir * 5, (int)r.min, (int)r.max);
    if (v == &settings.dim_level) dimPreviewUntil = (millis() + DIM_PREVIEW_MS) | 1;
  } else if (r.kind == ROW_TIME) {
    uint16_t* v = (uint16_t*)r.value;
    int m = dir > 0 ? (*v / 15 + 1) * 15 : ((*v + 14) / 15 - 1) * 15;
    *v = (m + 24 * 60) % (24 * 60);
  }
  configDirty = true;
}

void handleConfigTouch(const ConfigRow* rows, int n) {
  int x = touch.x, y = touch.y;
  if (y < HEADER_H) {
    int slot = x / TAB_W;
    if (slot == 4) { closeConfig(); return; }
    if (slot < configPageCount() && slot != configPage) { configPage = slot; configDirty = true; }
    return;
  }
  int i = (y - ROWS_Y) / ROW_H;
  if (y < ROWS_Y || i >= n) return;
  const ConfigRow& r = rows[i];
  if (r.kind == ROW_TOGGLE && x >= 560) {
    *(bool*)r.value = !*(bool*)r.value;
    configDirty = true;
  } else if (r.kind == ROW_ACTION && x >= 520) {
    startChime();
  } else if (r.kind == ROW_PERCENT || r.kind == ROW_TIME) {
    int dir = x >= 380 && x < 520 ? -1 : x >= 670 ? 1 : 0;
    if (!dir) return;
    stepRow(r, dir);
    heldRow = i; heldDir = dir;
    nextRepeat = millis() + REPEAT_DELAY_MS;
  }
}

// One loop pass while the settings are open.
void runConfig() {
  uint32_t now = millis();
  ConfigRow rows[4];
  int n = configRows(configPage, rows);

  if (touch.down) configLastTouch = now;
  if (!touch.down) heldRow = -1;
  if (touch.started) {
    heldRow = -1;
    handleConfigTouch(rows, n);
    if (!configOpen) return;
    n = configRows(configPage, rows);   // the page may have changed
  } else if (heldRow >= 0 && (int32_t)(now - nextRepeat) >= 0) {
    stepRow(rows[heldRow], heldDir);
    nextRepeat = now + REPEAT_MS;
  }
  if (now - configLastTouch >= CONFIG_IDLE_MS) { closeConfig(); return; }

  if (dimPreviewUntil && (int32_t)(now - dimPreviewUntil) >= 0) dimPreviewUntil = 0;
  setBacklightLevel(dimPreviewUntil ? min(settings.dim_level, settings.brightness)
                                    : settings.brightness, "settings");

  if (configDirty) {
    configDirty = false;
    drawConfig(rows, n);
  } else {
    delay(20);
  }
}

// ── Setup ───────────────────────────────────────────────────────────────────
void setup() {
  Serial.begin(115200);
  Serial.printf("Board: %s\n", CrowPanel7::boardName());

  if (!display.begin()) {
    Serial.println("Display init failed — is OPI PSRAM enabled in the board options?");
    while (true) delay(1000);
  }
  bindSprite();
  loadFonts();
  spr.setTextDatum(MC_DATUM);

  loadSettings();
  buildGammaLut();
  restoreTimeFromRtc();

  Serial.printf("Display %dx%d, double-buffered, %.1f fps; free internal RAM %u KB, PSRAM %u KB\n",
                SCREEN_W, SCREEN_H, display.measureFps(),
                heap_caps_get_free_size(MALLOC_CAP_INTERNAL) / 1024,
                heap_caps_get_free_size(MALLOC_CAP_SPIRAM) / 1024);
  logSettings("Loaded");

  // First frame is drawn into a framebuffer before the backlight comes on,
  // so the panel never shows uninitialized memory.
  showStatus("Color Clock", "Starting...", TFT_CYAN);
  backlightLevel = settings.brightness;
  display.setBrightness(backlightLevel);

  setupWiFi();
  applyTimeSettings();
  setupWebServer();
}

// ── Loop ────────────────────────────────────────────────────────────────────
void loop() {
  server.handleClient();
  checkWiFi();
  updateChime();
  pollTouch();

  if (testPatternUntil) {
    if ((int32_t)(millis() - testPatternUntil) < 0) { delay(50); return; }
    testPatternUntil = 0;
    lastS = -1;   // force a clock redraw
  }

  if (ntpSynced) {
    ntpSynced = false;
    if (display.writeRtc(time(nullptr))) Serial.println("RTC set from NTP");
  }

  if (configOpen) {
    runConfig();
    return;
  }

  struct tm ti;
  if (!getLocalTime(&ti, 10)) {
    delay(200);
    return;
  }

  bool tapWoke = updateScreenPower(ti);
  if (!tapWoke && backlightLevel == settings.brightness) checkCornerTaps();
  if (configOpen) return;
  checkHourlyChime(ti);

  int h = ti.tm_hour, m = ti.tm_min, s = ti.tm_sec;

  // Redraw if time changed OR settings changed
  bool settingsChanged = (settings.format_24h   != lastFmt24)
                      || (settings.show_seconds != lastSecs)
                      || (settings.show_date    != lastDate)
                      || (settings.gamma        != lastGamma)
                      || (wifiOnline            != lastOnline);
  if (h == lastH && m == lastM && s == lastS && !settingsChanged) {
    delay(chimeStep ? 5 : 50);   // step the chime on time
    return;
  }
  lastH = h; lastM = m; lastS = s;
  lastFmt24  = settings.format_24h;
  lastSecs   = settings.show_seconds;
  lastDate   = settings.show_date;
  lastGamma  = settings.gamma;
  lastOnline = wifiOnline;

  // ── Color from time ────────────────────────────────────────────────────
  uint8_t  R  = mapH(h);
  uint8_t  G  = mapM(m);
  uint8_t  B  = mapS(s);
  uint8_t  dR = gammaLut[R], dG = gammaLut[G], dB = gammaLut[B];   // as displayed
  uint16_t bg = rgb888to565(dR, dG, dB);
  uint16_t fg = bestTextColor(dR, dG, dB);

  spr.fillSprite(bg);
  spr.setTextColor(fg, bg);
  spr.setTextDatum(MC_DATUM);

  // ── Hex code ─────────────────────────────────────────────────────────
  char hexBuf[8];
  snprintf(hexBuf, sizeof(hexBuf), "#%02X%02X%02X", R, G, B);
  useFont(fontText56);
  spr.drawString(hexBuf, SCREEN_W/2, 50);

  // ── Time — digits pre-rendered at the size for this format, AM/PM beside ──
  String digits = formatTimeDigits(ti);
  const char* suffix = amPm(ti);
  SmoothFont& timeFont = !settings.show_seconds ? fontTimeL
                       : settings.format_24h    ? fontTimeM : fontTimeS;
  useFont(timeFont);
  int digitsW = spr.textWidth(digits);
  int digitsH = spr.fontHeight();
  int suffixW = 0;
  if (*suffix) {
    useFont(fontText56);
    suffixW = TIME_SUFFIX_GAP + spr.textWidth(suffix);
  }
  int timeX    = (SCREEN_W - digitsW - suffixW) / 2;
  int baseline = (settings.show_date ? 205 : 240) + digitsH / 2;
  spr.setTextDatum(L_BASELINE);
  useFont(timeFont);
  spr.drawString(digits, timeX, baseline);
  if (*suffix) {
    useFont(fontText56);
    spr.drawString(suffix, timeX + digitsW + TIME_SUFFIX_GAP, baseline);
  }
  spr.setTextDatum(MC_DATUM);

  // ── Date (optional) ──────────────────────────────────────────────────
  if (settings.show_date) {
    String dateStr = String(dayNames[ti.tm_wday]) + "  " +
                     pad2(ti.tm_mday) + " " +
                     monthNames[ti.tm_mon] + " " +
                     String(1900 + ti.tm_year);
    useFont(fontText56);
    spr.drawString(dateStr, SCREEN_W/2, 365);
  }

  // ── RGB strip ────────────────────────────────────────────────────────
  useFont(fontText24);
  char rgbBuf[28];
  snprintf(rgbBuf, sizeof(rgbBuf), "R:%3d   G:%3d   B:%3d", R, G, B);
  spr.drawString(rgbBuf, SCREEN_W/2, 450);

  if (!wifiOnline) {
    spr.setTextDatum(TR_DATUM);
    spr.drawString("No WiFi", SCREEN_W - 16, 12);
    spr.setTextDatum(MC_DATUM);
  }

  presentFrame();

  Serial.printf("%s  %s\n", formatTime(ti).c_str(), hexBuf);
}
